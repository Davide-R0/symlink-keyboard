## src-zmk/Kconfig
```kconfig
# Kconfig

# Carica le configurazioni di default di Zephyr/ZMK
rsource "zephyr/Kconfig"

# Si può abilitare questo modulo con CONFIG_CUSTOM_CIRQUE_TRACKPAD=y nel file .conf della shield
config CUSTOM_CIRQUE_TRACKPAD
    bool "Enable Custom Cirque Trackpad Driver via PCA9536D"
    default n
    help
      Abilita il driver custom in C per il modulo touchpad Cirque
      collegato tramite l'IO expander PCA9536D I2C.
```

## src-zmk/boards/shields/my_shield/Kconfig.defconfig
```kconfig
# src-zmk/boards/shields/my_shield/Kconfig.defconfig

# --- IMPOSTAZIONI LATO SINISTRO (MASTER) ---
if SHIELD_MY_SHIELD_LEFT

# Diamo un nome Bluetooth personalizzato alla tastiera
config ZMK_KEYBOARD_NAME
    default "My Custom Split"

# Accendiamo l'encoder rotativo di default solo a sinistra
config EC11
    default y

config EC11_TRIGGER_GLOBAL_THREAD
    default y

endif # SHIELD_MY_SHIELD_LEFT


# --- IMPOSTAZIONI LATO DESTRO (SLAVE) ---
if SHIELD_MY_SHIELD_RIGHT

# Il lato destro non trasmette il nome via BLE al PC, ma è buona norma impostarlo
config ZMK_KEYBOARD_NAME
    default "My Custom Split Right"

# In futuro qui potresti mettere il default a 'y' per il tuo driver I2C custom
# config CUSTOM_CIRQUE_TRACKPAD
#     default y

endif # SHIELD_MY_SHIELD_RIGHT
```

## src-zmk/boards/shields/my_shield/Kconfig.shield
```kconfig
# src-zmk/boards/shields/my_shield/Kconfig.shield

config SHIELD_MY_SHIELD_LEFT
    def_bool $(shields_list_contains,my_shield_left)

config SHIELD_MY_SHIELD_RIGHT
    def_bool $(shields_list_contains,my_shield_right)
```
